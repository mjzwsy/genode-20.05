## ANY/uboot-2016/configs/mx6q-s3-2g-sabresd_defconfig
```kconfig
CONFIG_ARM=y
CONFIG_ARCH_MX6=y
CONFIG_TARGET_MX6SABRESD=y
CONFIG_SYS_EXTRA_OPTIONS="IMX_CONFIG=board/freescale/mx6sabresd/mx6q_sabresd_s3_2g.cfg,MX6Q,SYS_USE_SPINOR,MAIN_BOARD_IS_S3,CPU_TYPE_IS_Q,DDR_IS_2G"
CONFIG_CMD_GPIO=y
CONFIG_MAIN_BOARD_IS_S3=y
```
